; Load a multi-uimg file to DDR RAM, and then trigger MP1-Boot to process it
; This assumes this script is in flashing/, and the uimg file is build/main.uimg
; and the elf file (used for symbols) is build/mp1corea7/medium/main.elf

PRIVATE &builddir
&builddir=OS.PPF()
&builddir=OS.FILE.PATH("&builddir")

PRIVATE &elffile
&elffile=OS.FILE.JOINPATH("&builddir", "../", "build", "fsbl.elf")
&elffile=OS.FILE.REALPATH("&elffile")

RESet
SYStem.RESet

SYStem.CPU STM32MP135D
SYStem.JtagClock 50MHz

Trace.DISable
SYStem.MemAccess DAP
SYStem.Up

Data.LOAD.Elf "&elffile" /CPP /NoCode

Trace.METHOD ONCHIP
ETM.Trace ON
ETM.ON

Trace.arm
ENDDO
